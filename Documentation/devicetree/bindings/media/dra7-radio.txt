## Documentation/devicetree/bindings/media/dra7-radio.txt
```
Texas Instruments DRA7xx Radio Helper

Radio Helper is a dummy device on top of the devices such as McAsp
that needs to be configured for Radio playback.
The corresponding platform driver configures these devices as
required.

Top node:
Required properties:
- compatible: "ti,dra7xx_radio"
- gpios:  list of the gpios that needs to be configured

child nodes:
- compatible: "ti,dra7xx_radio_subdev"
- ti,hwmods: Name of the hwmod associated to the underlying devices
- status: Device status
- Optional properties:
	- fck_parent : Should contain a valid clock name which will be used as parent
	       for the device's fck
```

## drivers/media/video/omap/Kconfig
```kconfig
config VIDEO_OMAP2_VOUT
	tristate "OMAP2+ V4L2-Display driver"
	depends on ARCH_OMAP2PLUS
	select VIDEOBUF_GEN
	select VIDEOBUF_DMA_CONTIG
	select OMAP2_DSS
	select OMAP2_VRAM
	select OMAP2_VRFB if ARCH_OMAP2 || ARCH_OMAP3
	default n
	---help---
	  V4L2 Display driver support for OMAP2+ based boards.
```
